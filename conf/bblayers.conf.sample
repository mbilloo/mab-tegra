## conf/bblayers.conf.sample
```bitbake
# Version of layers configuration, specific to
# each defined distro in the repository.
# Format: ${DISTRO}-<version>
TD_BBLAYERS_CONF_VERSION = "tegrademo-3"

BBPATH = "${TOPDIR}"
BBFILES ?= ""
BSPDIR := "${@os.path.abspath(os.path.dirname(d.getVar('FILE')) + '/../..')}"

BBLAYERS ?= " \
  ${BSPDIR}/sources/poky/meta \
  ${BSPDIR}/sources/meta-tegra \
  ${BSPDIR}/sources/meta-mab-tegra \
  ${BSPDIR}/sources/meta-mab-tegra-support \
  ${BSPDIR}/sources/meta-tegra/contrib \
  ${BSPDIR}/sources/meta-openembedded/meta-oe \
  ${BSPDIR}/sources/meta-openembedded/meta-python \
  ${BSPDIR}/sources/meta-openembedded/meta-networking \
  ${BSPDIR}/sources/meta-openembedded/meta-filesystems \
  ${BSPDIR}/sources/meta-virtualization \
  "
```

## conf/layer.conf
```bitbake
BBPATH =. "${LAYERDIR}:"
BBFILES += "${LAYERDIR}/recipes-*/*/*.bb ${LAYERDIR}/recipes-*/*/*.bbappend"

BBFILE_COLLECTIONS += "mab-tegra"
BBFILE_PATTERN_mab-tegra = "^${LAYERDIR}/"
BBFILE_PRIORITY_mab-tegra = "50"

LAYERVERSION_teg = "4"
LAYERSERIES_COMPAT_mab-tegra = "dunfell"

# This is used by the tegra-distro-sanity bbclass
# to identify the distro layer directory during
# bblayers checks.
TD_DISTRO_LAYERDIR = "${LAYERDIR}"
```
